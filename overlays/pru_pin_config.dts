
/dts-v1/;
/plugin/;

#include "dt-bindings/pinctrl/am33xx.h"

&am33xx_pinmux {

	/* make static pin config init at boot */
	pinctrl-names = "default";
	pinctrl-0 = <&choen_static_pincfg>;

	choen_static_pincfg: choen_static_pincfg {
		pinctrl-single,pins = <
			AM33XX_PADCONF(AM335X_PIN_MCASP0_AXR0, PIN_OUTPUT_PULLUP, MUX_MODE5)   /*P9_30-102-pr1_pru0_pru_r30_2*/
		>;
	};
};